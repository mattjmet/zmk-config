#define CONFIG_WIRELESS
#define ZMK_BASE_LAYER(name, LT, RT, LM, RM, LB, RB, LH, RH)                   \
    ZMK_LAYER(                                                                 \
        name,                                                                  \
                 LT RT                                                         \
                 LM RM                                                         \
                 LB RB                                                         \
         &leader LH RH SMART_APP                                               \
    )

#include "zmk-helpers/key-labels/36.h"
#include "base.keymap"

/{ chosen { zmk,physical-layout = &foostan_corne_5col_layout; }; };
